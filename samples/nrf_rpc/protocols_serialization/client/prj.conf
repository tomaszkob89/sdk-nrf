## CMakeLists.txt
```
#
# Copyright (c) 2024 Nordic Semiconductor ASA
#
# SPDX-License-Identifier: LicenseRef-Nordic-5-Clause
#
cmake_minimum_required(VERSION 3.20.0)

find_package(Zephyr REQUIRED HINTS $ENV{ZEPHYR_BASE})

project(protocols_serialization_client)



set(TCA_TRANSPORT "RTT" CACHE STRING "TCA transport type")
execute_process(COMMAND ctf_tca -r lib OUTPUT_VARIABLE TCA_TARGET_LIB_DIR)
string(STRIP ${TCA_TARGET_LIB_DIR} TCA_TARGET_LIB_DIR) # strip new line character
include(${TCA_TARGET_LIB_DIR}/CMakeLists.txt)
target_link_libraries(app PRIVATE ctfTargetComm)


# NORDIC SDK APP START
target_sources(app PRIVATE
    src/main.c
)

zephyr_library_sources_ifdef(CONFIG_OPENTHREAD_RPC src/ot_shell.c)
zephyr_library_sources_ifdef(CONFIG_MPSL_CX_SOFTWARE src/coex_shell.c)
zephyr_library_sources_ifdef(CONFIG_LOG_FORWARDER_RPC src/log_rpc_shell.c)
# NORDIC SDK APP START
```

## Kconfig
```
#
# Copyright (c) 2024 Nordic Semiconductor ASA
#
# SPDX-License-Identifier: LicenseRef-Nordic-5-Clause
#

menu "Protocols serialization client"

config BT_CTLR
	default n

choice BT_NUS_LOG_LEVEL_CHOICE
	default BT_NUS_LOG_LEVEL_DBG if DEBUG
endchoice

config RPC_CRASH_LOG_READ_BUFFER_SIZE
	int "Crash log read buffer size"
	depends on LOG_FORWARDER_RPC
	default 256
	help
	  Size of the stack buffer used for reading a single chunk of the crash
	  log from the server device.

module = NRF_PS_CLIENT
module-str = nrf_ps_client
source "${ZEPHYR_BASE}/subsys/logging/Kconfig.template.log_config"

endmenu # "Protocols serialization client"

# get TCA config options
source "$(shell, ctf-targetcomm -r lib)/zephyr/Kconfig"

# menu "Zephyr Kernel"
# source "Kconfig.zephyr"
# endmenu
```

## prj.conf
```kconfig
#
# Copyright (c) 2024 Nordic Semiconductor
#
# SPDX-License-Identifier: LicenseRef-Nordic-5-Clause
#
CONFIG_HEAP_MEM_POOL_SIZE=4096

CONFIG_NRF_RPC=y
CONFIG_NRF_RPC_CBOR=y
CONFIG_NRF_RPC_ZCBOR_BACKUPS=1
CONFIG_NRF_RPC_THREAD_STACK_SIZE=4096
CONFIG_NRF_RPC_GROUP_INIT_WAIT_TIME=-1
CONFIG_NRF_RPC_UART_TRANSPORT=y

CONFIG_UART_LINE_CTRL=y
CONFIG_UART_INTERRUPT_DRIVEN=y

CONFIG_SHELL=y
CONFIG_LOG=y
CONFIG_LOG_MODE_DEFERRED=y
CONFIG_LOG_BUFFER_SIZE=4096
CONFIG_LOG_FUNC_NAME_PREFIX_DBG=n
CONFIG_LOG_BACKEND_RTT=n
CONFIG_SHELL_LOG_BACKEND=y


#########################################3
CONFIG_POLL=y
CONFIG_GPIO=y
CONFIG_USE_SEGGER_RTT=n

CONFIG_SERIAL=n
CONFIG_UART_CONSOLE=n
CONFIG_LOG_BACKEND_UART=n
CONFIG_BOOT_BANNER=n
# malloc used by test_common/test_events.c and tca_transports/uart_zephyr_async.c
CONFIG_MINIMAL_LIBC_MALLOC_ARENA_SIZE=512
# allows Ozone and GDB to monitor active threads
CONFIG_DEBUG_THREAD_INFO=y
# dont restart the board when fatal error occurs
CONFIG_RESET_ON_FATAL_ERROR=n
# enable zephyr logging
CONFIG_LOG=y
CONFIG_LOG_MODE_DEFERRED=y
# needed for custom log backend when NCS > v2.0.2
CONFIG_LOG_OUTPUT=y
# use TCA log backend
CONFIG_TCA_LOG_BACKEND=y
# thread stack guard (not supported on Cortex-M4)
CONFIG_BUILTIN_STACK_GUARD=y

CONFIG_TCA_MAX_PACKET_PAYLOAD_SIZE=8200

# CONFIG_TCA_TRANSPORT_UART_ZEPHYR=y
CONFIG_TCA_TRANSPORT_RTT=y
```

## src/main.c
```c
/*
 * Copyright (c) 2024 Nordic Semiconductor ASA
 *
 * SPDX-License-Identifier: LicenseRef-Nordic-5-Clause
 */

#include <zephyr/logging/log.h>

#include <nrf_rpc.h>

#include <target_comm.h>
#include <tca_transport.h>
#include <tca_nrf_error.h>
#include <tca_zephyr_log_backend.h>

target_comm_t g_target_comm;
const int TCA_LOG_EVENT_TYPE = 100;

LOG_MODULE_REGISTER(nrf_ps_client, CONFIG_NRF_PS_CLIENT_LOG_LEVEL);

static void err_handler(const struct nrf_rpc_err_report *report)
{
	LOG_ERR("nRF RPC error %d ocurred. See nRF RPC logs for more details", report->code);
}

int main(void)
{
	int ret;

	tca_transport_config_t transport_config = TCA_TRANSPORT_CONFIG_DEFAULT;
	tca_init(&g_target_comm, &transport_config);

	#ifdef CONFIG_TCA_LOG_BACKEND
		// disable all backends in zephyr which have autostart enabled
		tca_zephyr_log_disable_all_backends();
		tca_zephyr_log_enable_backend(&g_target_comm, TCA_LOG_EVENT_TYPE, LOG_LEVEL_ERR);
	#endif


	LOG_INF("Initializing RPC client");

	ret = nrf_rpc_init(err_handler);

	if (ret != 0) {
		LOG_ERR("RPC init failed");
	}

	LOG_INF("RPC client ready");

	while (1)
    {
        tca_send_and_receive(&g_target_comm);
        k_yield();
    }

	return 0;
}
```
